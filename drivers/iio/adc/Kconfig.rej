## drivers/iio/adc/Kconfig.rej
```kconfig
--- home/setra/setra/linux-bsp/linux-toradex/drivers/iio/adc/Kconfig	2016-02-23 20:50:42.633460445 +0530
+++ drivers/iio/adc/Kconfig	2016-03-04 14:29:52.167737675 +0530
@@ -331,8 +333,6 @@
 config VF610_ADC
 	tristate "Freescale vf610 ADC driver"
 	depends on OF
-	select IIO_BUFFER
-	select IIO_TRIGGERED_BUFFER
 	help
 	  Say yes here to support for Vybrid board analog-to-digital converter.
 	  Since the IP is used for i.MX6SLX, the driver also support i.MX6SLX.
```
